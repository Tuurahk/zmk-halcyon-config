## config/west.yml
```yaml
manifest:
  remotes:
    - name: splitkb
      url-base: https://github.com/splitkb
    # Additional modules containing boards/shields/custom code can be listed here as well
    # See https://docs.zephyrproject.org/3.2.0/develop/west/manifest.html#projects
  projects:
    - name: zmk
      remote: splitkb
      revision: main+halcyon-fixes
      import: app/west.yml
    - name: zmk-halcyon-config
      url: https://github.com/Tuurahk/zmk-halcyon-config
      revision: develop
      path: modules/zmk-halcyon-config
    - name: zmk-halcyon-module
      url: https://github.com/Tuurahk/zmk-halcyon-module
      revision: develop
  self:
    path: config
```
